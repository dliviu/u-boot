## board/rockchip/generic_rk3399/Kconfig
```kconfig
if TARGET_GENERIC_RK3399

config SYS_BOARD
	default "generic_rk3399"

config SYS_VENDOR
	default "rockchip"

config SYS_CONFIG_NAME
	default "board_rk3399"

config BOARD_SPECIFIC_OPTIONS # dummy
	def_bool y

endif
```
