// SPDX-License-Identifier: GPL-2.0+
/*
 * (C) 2018 Liviu Dudau <liviu@dudau.co.uk>
 */

&dmc {
        rockchip,sdram-params = <
		0x2
		0xa
		0x3
		0x2
		0x2
		0x0
		0xf
		0xf
		1
		0x801d181e
		0x17050a08
		0x00000002
		0x00006426
		0x0000004c
		0x00000000
		0x2
		0xa
		0x3
		0x2
		0x2
		0x0
		0xf
		0xf
		1
		0x801d181e
		0x17050a08
		0x00000002
		0x00006426
		0x0000004c
		0x00000000
		933
		6
		2
		13
		1
		0x00000700
		0x00000000
		0x00000000
		0x00000000
		0x00000000
		0x0000005e
		0x0002d976
		0x000003a6
		0x0000247a
		0x0000005e
		0x0002d976
		0x000003a6
		0x0000247a
		0x0000005e
		0x0002d976
		0x000003a6
		0x0100247a
		0x00000000
		0x00000101
		0x00020100
		0x000000bb
		0x000001d3
		0x00000000
		0x081c0000
		0x00081c00
		0x0400081c
		0x3b0a0004
		0x2f110828
		0x283b0a00
		0x002f1108
		0x08283b0a
		0x08002f11
		0x00000a0a
		0x0800ff4f
		0x0a0a080f
		0x0800ff4f
		0x0a0a080f
		0x0800ff4f
		0x0203000f
		0x110f1100
		0x040f110f
		0x14000a0a
		0x03030a0a
		0x00010003
		0x03212121
		0x00141414
		0x00000000
		0x03010000
		0x0e3100c5
		0x0e3100c5
		0x0e3100c5
		0x00000000
		0x00080008
		0x00170008
		0x00170017
		0x00111111
		0x00000000
		0x00000000
		0x00000000
		0x00ce0000
		0x00ce00ce
		0x00ce00ce
		0x000000ce
		0x00000000
		0x00000000
		0x00000000
		0x00000000
		0x00000000
		0x00000000
		0x00000301
		0x00000001
		0x00000000
		0x00000000
		0x01000000
		0x80104002
		0x00040003
		0x00040005
		0x00030000
		0x00050004
		0x00000004
		0x00040003
		0x00040005
		0x38c40000
		0x00001c62
		0x1c6238c4
		0x38c40000
		0x00001c62
		0x00000000
		0x00000000
		0x00000000
		0x00000000
		0x00000000
		0x02020200
		0x00020202
		0x00030200
		0x00040700
		0x00000302
		0x02000407
		0x00000003
		0x00030f04
		0x00070004
		0x00000000
		0x00000000
		0x00000000
		0x00000000
		0x00000000
		0x00000000
		0x00000000
		0x00010000
		0x20040020
		0x00200400
		0x01000400
		0x00000b80
		0x00000000
		0x00000001
		0x00000002
		0x0000000e
		0x00000000
		0x00000000
		0x00000000
		0x00000000
		0x00000000
		0x00bb0000
		0x00ea005e
		0x00ea0000
		0x005e00bb
		0x000000ea
		0x00bb00ea
		0x00ea005e
		0x00ea0000
		0x00000000
		0x00000000
		0x00000000
		0x00c30000
		0x0000001c
		0x001c00c3
		0x00c30000
		0x0000001c
		0x00010001
		0x07000001
		0x00000707
		0x00000000
		0x00000000
		0x00000000
		0x00000000
		0x00000000
		0x00000000
		0x00c30000
		0x0000001c
		0x001c00c3
		0x00c30000
		0x0000001c
		0x00010001
		0x07000001
		0x00000707
		0x00000000
		0x00000000
		0x00000000
		0x00000000
		0x00000000
		0x00000000
		0x01000000
		0x00000000
		0x00000000
		0x18151100
		0x0000000c
		0x00000000
		0x00000000
		0x00000000
		0x00000000
		0x00000000
		0x00000000
		0x00000000
		0x00000000
		0x00000000
		0x00000000
		0x00000000
		0x00000000
		0x00000000
		0x0003a603
		0x00550151
		0x00000000
		0x015103a6
		0x00000055
		0x0003a600
		0x00550151
		0x00000000
		0x002f0000
		0x002f002f
		0x01010100
		0x01000202
		0x0a000002
		0x01000f0f
		0x00000000
		0x00000000
		0x00010003
		0x00000c03
		0x00000100
		0x00010000
		0x01000000
		0x00010000
		0x00000001
		0x00000000
		0x00000000
		0x00000000
		0x00000000
		0x00000000
		0x00000000
		0x00000000
		0x00000000
		0x00000000
		0x00010000
		0x04040401
		0x01010808
		0x04040001
		0x0c0c0c04
		0x08080808
		0x08050103
		0x08050103
		0x00050103
		0x00020202
		0x06030600
		0x00030603
		0x00000000
		0x00000000
		0x0d000001
		0x00010028
		0x00010000
		0x00000003
		0x00000000
		0x00000000
		0x00000000
		0x00000000
		0x00000000
		0x00000000
		0x00000000
		0x00000000
		0x00010100
		0x01000000
		0x00000001
		0x00000303
		0x00000000
		0x00000000
		0x00000000
		0x00000000
		0x00000000
		0x00000000
		0x00000000
		0x00000000
		0x00000000
		0x00000000
		0x00000000
		0x00000000
		0x00000000
		0x00000000
		0x00000000
		0x000556aa
		0x000aaaaa
		0x000aa955
		0x00055555
		0x000b3133
		0x0004cd33
		0x0004cecc
		0x000b32cc
		0x00010300
		0x03000100
		0x00000000
		0x00000000
		0x00000000
		0x00000000
		0x00000000
		0x00000000
		0x00000000
		0x00000000
		0x00ffff00
		0x20200000
		0x08000020
		0x00001c62
		0x00000200
		0x00000200
		0x00000200
		0x00000200
		0x00001c62
		0x00011bd4
		0x1c62070c
		0x00000200
		0x00000200
		0x00000200
		0x00000200
		0x00001c62
		0x00011bd4
		0x1c62070c
		0x00000200
		0x00000200
		0x00000200
		0x00000200
		0x00001c62
		0x00011bd4
		0x0202070c
		0x03030202
		0x00000018
		0x00000000
		0x00000000
		0x00001403
		0x00000000
		0x00000000
		0x00000000
		0x00030000
		0x000f0021
		0x000f0021
		0x000f0021
		0x00000000
		0x00000000
		0x01000000
		0x02090209
		0x00050209
		0x00000000
		0x00000000
		0x00000000
		0x00000000
		0x00000000
		0x00000000
		0x00000000
		0x00000000
		0x01000101
		0x01010101
		0x01000101
		0x01000100
		0x00010001
		0x00010002
		0x00020100
		0x00000002
		0x00000700
		0x00000000
		0x000038c4
		0x00001c62
		0x000038c4
		0x00001c62
		0x000038c4
		0x1c621c62
		0x00000200
		0x00000200
		0x00000200
		0x00000200
		0x00001c62
		0x00000200
		0x00000200
		0x00000200
		0x00000200
		0x00001c62
		0x00000200
		0x00000200
		0x00000200
		0x00000200
		0x00010000
		0x00000007
		0x81000001
		0x0f0003f0
		0x3fffffff
		0x0f0000a0
		0x377ff000
		0x0f000020
		0x377ff000
		0x0f000030
		0x377ff000
		0x0f0000b0
		0x377ff000
		0x0f000100
		0x377ff000
		0x0f000110
		0x377ff000
		0x0f000010
		0x377ff000
		0x03000101
		0x04323232
		0x081c0008
		0x00081c00
		0x0000001c
		0x0e3100c5
		0x0e3100c5
		0x0e3100c5
		0x00000500
		0x00000000
		0x00000000
		0x00000000
		0x00000000
		0x00000000
		0x00000000
		0x00000000
		0x00000000
		0x04040000
		0x0d000004
		0x00000128
		0x00000000
		0x00030003
		0x00000018
		0x00000000
		0x00000000
		0x04060002
		0x04010401
		0x00080801
		0x00020001
		0x00080004
		0x00000000
		0x04040000
		0x0c0c0c04
		0x00000000
		0x00000000
		0x00000000
		0x00030300
		0x00000014
		0x00000000
		0x01010300
		0x00000000
		0x00000000
		0x01000000
		0x00000101
		0x55555a5a
		0x55555a5a
		0x55555a5a
		0x55555a5a
		0x0c0c0001
		0x0707000c
		0x02020007
		0x00000102
		0x00030000
		0x17030000
		0x000f0021
		0x000f0021
		0x000f0021
		0x00000000
		0x00000000
		0x00000100
		0x140a0000
		0x000a030a
		0x03000a03
		0x010a000a
		0x00000100
		0x01000000
		0x00000000
		0x00000100
		0x1e1a0000
		0x10010204
		0x07070705
		0x20000202
		0x00201000
		0x00201000
		0x04041000
		0x12120100
		0x00010112
		0x004b004a
		0x1a030000
		0x0102041e
		0x34000000
		0x00000000
		0x00000000
		0x00000000
		0x0000c300
		0x0001001c
		0x004d4d07
		0x001c00c3
		0x4d070001
		0x0000c34d
		0x0001001c
		0x004d4d07
		0x001c00c3
		0x4d070001
		0x0000c34d
		0x0001001c
		0x004d4d07
		0x001c00c3
		0x4d070001
		0x00c3004d
		0x0001001c
		0x004d4d07
		0x001c00c3
		0x4d070001
		0x0000c34d
		0x0001001c
		0x004d4d07
		0x001c00c3
		0x4d070001
		0x0000c34d
		0x0001001c
		0x004d4d07
		0x001c00c3
		0x4d070001
		0x0100004d
		0x00ea00ea
		0x080400ea
		0x0f081114
		0x2800fcc1
		0x0a0e2006
		0x1114080a
		0x00000f08
		0x2800fcc1
		0x0a0e2006
		0x1114080a
		0x00000f08
		0x2800fcc1
		0x0a0e2006
		0x0200020a
		0x02000200
		0x02000200
		0x02000200
		0x02000200
		0x00000000
		0x00000000
		0x00000000
		0x00000000
		0x00000000
		0x00000000
		0x00000000
		0x00000000
		0x00000000
		0x00000000
		0x00000000
		0x00000000
		0x01000300
		0x001c6200
		0x00011bd4
		0x00001c62
		0x00011bd4
		0x00001c62
		0x00011bd4
		0x08000000
		0x00000100
		0x00000000
		0x00000000
		0x00000000
		0x00000000
		0x00000002
		0x76543210
		0x0004c008
		0x000001a2
		0x00000000
		0x00000000
		0x00010000
		0x01665555
		0x00665555
		0x00010f00
		0x06010200
		0x00000003
		0x001700c0
		0x00cc0101
		0x00030066
		0x00000000
		0x00000000
		0x00000000
		0x00000000
		0x00000000
		0x00000000
		0x00000000
		0x00000000
		0x04080000
		0x04080400
		0x08000000
		0x0c00c007
		0x00000100
		0x00000100
		0x55555555
		0xaaaaaaaa
		0x55555555
		0xaaaaaaaa
		0x00005555
		0x00000000
		0x00000000
		0x00000000
		0x00000000
		0x00000000
		0x00000000
		0x00000000
		0x00000000
		0x00000000
		0x00000000
		0x00000000
		0x00000000
		0x00000000
		0x00000000
		0x00000000
		0x00000000
		0x00000000
		0x00000000
		0x00000000
		0x00200000
		0x00000000
		0x00000000
		0x00000000
		0x00000000
		0x00000000
		0x00000000
		0x02700270
		0x02700270
		0x02700270
		0x02700270
		0x00000270
		0x00000000
		0x00000000
		0x00000000
		0x00000000
		0x00800000
		0x00800080
		0x00800080
		0x00800080
		0x00800080
		0x00800080
		0x00800080
		0x00800080
		0x00800080
		0x01a20080
		0x00000003
		0x00000000
		0x00030000
		0x00000200
		0x00000000
		0x51315152
		0xc0013150
		0x020000c0
		0x00100001
		0x07064208
		0x000f0c18
		0x01000140
		0x00000c20
		0x00000000
		0x00000000
		0x00000000
		0x00000000
		0x00000000
		0x00000000
		0x00000000
		0x00000000
		0x00000000
		0x00000000
		0x00000000
		0x00000000
		0x00000000
		0x00000000
		0x00000000
		0x00000000
		0x00000000
		0x00000000
		0x00000000
		0x00000000
		0x00000000
		0x00000000
		0x00000000
		0x00000000
		0x00000000
		0x00000000
		0x00000000
		0x00000000
		0x00000000
		0x00000000
		0x00000000
		0x00000000
		0x00000000
		0x00000000
		0x00000000
		0x00000000
		0x00000000
		0x76543210
		0x0004c008
		0x000001a2
		0x00000000
		0x00000000
		0x00010000
		0x01665555
		0x00665555
		0x00010f00
		0x06010200
		0x00000003
		0x001700c0
		0x00cc0101
		0x00030066
		0x00000000
		0x00000000
		0x00000000
		0x00000000
		0x00000000
		0x00000000
		0x00000000
		0x00000000
		0x04080000
		0x04080400
		0x08000000
		0x0c00c007
		0x00000100
		0x00000100
		0x55555555
		0xaaaaaaaa
		0x55555555
		0xaaaaaaaa
		0x00005555
		0x00000000
		0x00000000
		0x00000000
		0x00000000
		0x00000000
		0x00000000
		0x00000000
		0x00000000
		0x00000000
		0x00000000
		0x00000000
		0x00000000
		0x00000000
		0x00000000
		0x00000000
		0x00000000
		0x00000000
		0x00000000
		0x00000000
		0x00200000
		0x00000000
		0x00000000
		0x00000000
		0x00000000
		0x00000000
		0x00000000
		0x02700270
		0x02700270
		0x02700270
		0x02700270
		0x00000270
		0x00000000
		0x00000000
		0x00000000
		0x00000000
		0x00800000
		0x00800080
		0x00800080
		0x00800080
		0x00800080
		0x00800080
		0x00800080
		0x00800080
		0x00800080
		0x01a20080
		0x00000003
		0x00000000
		0x00030000
		0x00000200
		0x00000000
		0x51315152
		0xc0013150
		0x020000c0
		0x00100001
		0x07064208
		0x000f0c18
		0x01000140
		0x00000c20
		0x00000000
		0x00000000
		0x00000000
		0x00000000
		0x00000000
		0x00000000
		0x00000000
		0x00000000
		0x00000000
		0x00000000
		0x00000000
		0x00000000
		0x00000000
		0x00000000
		0x00000000
		0x00000000
		0x00000000
		0x00000000
		0x00000000
		0x00000000
		0x00000000
		0x00000000
		0x00000000
		0x00000000
		0x00000000
		0x00000000
		0x00000000
		0x00000000
		0x00000000
		0x00000000
		0x00000000
		0x00000000
		0x00000000
		0x00000000
		0x00000000
		0x00000000
		0x00000000
		0x76543210
		0x0004c008
		0x000001a2
		0x00000000
		0x00000000
		0x00010000
		0x01665555
		0x00665555
		0x00010f00
		0x06010200
		0x00000003
		0x001700c0
		0x00cc0101
		0x00030066
		0x00000000
		0x00000000
		0x00000000
		0x00000000
		0x00000000
		0x00000000
		0x00000000
		0x00000000
		0x04080000
		0x04080400
		0x08000000
		0x0c00c007
		0x00000100
		0x00000100
		0x55555555
		0xaaaaaaaa
		0x55555555
		0xaaaaaaaa
		0x00005555
		0x00000000
		0x00000000
		0x00000000
		0x00000000
		0x00000000
		0x00000000
		0x00000000
		0x00000000
		0x00000000
		0x00000000
		0x00000000
		0x00000000
		0x00000000
		0x00000000
		0x00000000
		0x00000000
		0x00000000
		0x00000000
		0x00000000
		0x00200000
		0x00000000
		0x00000000
		0x00000000
		0x00000000
		0x00000000
		0x00000000
		0x02700270
		0x02700270
		0x02700270
		0x02700270
		0x00000270
		0x00000000
		0x00000000
		0x00000000
		0x00000000
		0x00800000
		0x00800080
		0x00800080
		0x00800080
		0x00800080
		0x00800080
		0x00800080
		0x00800080
		0x00800080
		0x01a20080
		0x00000003
		0x00000000
		0x00030000
		0x00000200
		0x00000000
		0x51315152
		0xc0013150
		0x020000c0
		0x00100001
		0x07064208
		0x000f0c18
		0x01000140
		0x00000c20
		0x00000000
		0x00000000
		0x00000000
		0x00000000
		0x00000000
		0x00000000
		0x00000000
		0x00000000
		0x00000000
		0x00000000
		0x00000000
		0x00000000
		0x00000000
		0x00000000
		0x00000000
		0x00000000
		0x00000000
		0x00000000
		0x00000000
		0x00000000
		0x00000000
		0x00000000
		0x00000000
		0x00000000
		0x00000000
		0x00000000
		0x00000000
		0x00000000
		0x00000000
		0x00000000
		0x00000000
		0x00000000
		0x00000000
		0x00000000
		0x00000000
		0x00000000
		0x00000000
		0x76543210
		0x0004c008
		0x000001a2
		0x00000000
		0x00000000
		0x00010000
		0x01665555
		0x00665555
		0x00010f00
		0x06010200
		0x00000003
		0x001700c0
		0x00cc0101
		0x00030066
		0x00000000
		0x00000000
		0x00000000
		0x00000000
		0x00000000
		0x00000000
		0x00000000
		0x00000000
		0x04080000
		0x04080400
		0x08000000
		0x0c00c007
		0x00000100
		0x00000100
		0x55555555
		0xaaaaaaaa
		0x55555555
		0xaaaaaaaa
		0x00005555
		0x00000000
		0x00000000
		0x00000000
		0x00000000
		0x00000000
		0x00000000
		0x00000000
		0x00000000
		0x00000000
		0x00000000
		0x00000000
		0x00000000
		0x00000000
		0x00000000
		0x00000000
		0x00000000
		0x00000000
		0x00000000
		0x00000000
		0x00200000
		0x00000000
		0x00000000
		0x00000000
		0x00000000
		0x00000000
		0x00000000
		0x02700270
		0x02700270
		0x02700270
		0x02700270
		0x00000270
		0x00000000
		0x00000000
		0x00000000
		0x00000000
		0x00800000
		0x00800080
		0x00800080
		0x00800080
		0x00800080
		0x00800080
		0x00800080
		0x00800080
		0x00800080
		0x01a20080
		0x00000003
		0x00000000
		0x00030000
		0x00000200
		0x00000000
		0x51315152
		0xc0013150
		0x020000c0
		0x00100001
		0x07064208
		0x000f0c18
		0x01000140
		0x00000c20
		0x00000000
		0x00000000
		0x00000000
		0x00000000
		0x00000000
		0x00000000
		0x00000000
		0x00000000
		0x00000000
		0x00000000
		0x00000000
		0x00000000
		0x00000000
		0x00000000
		0x00000000
		0x00000000
		0x00000000
		0x00000000
		0x00000000
		0x00000000
		0x00000000
		0x00000000
		0x00000000
		0x00000000
		0x00000000
		0x00000000
		0x00000000
		0x00000000
		0x00000000
		0x00000000
		0x00000000
		0x00000000
		0x00000000
		0x00000000
		0x00000000
		0x00000000
		0x00000000
		0x00000000
		0x00800000
		0x00000000
		0x00000000
		0x00000000
		0x00000000
		0x00000000
		0x00000001
		0x00000000
		0x00000000
		0x00000000
		0x00400320
		0x00000040
		0x00806420
		0x00917531
		0x00806420
		0x01917531
		0x00020003
		0x00000000
		0x00000000
		0x00000000
		0x000556aa
		0x000aaaaa
		0x000aa955
		0x00055555
		0x000b3133
		0x0004cd33
		0x0004cecc
		0x000b32cc
		0x0a418820
		0x103f0000
		0x0000003f
		0x00038055
		0x03800380
		0x03800380
		0x00000380
		0x42080010
		0x00000003
		0x00000000
		0x00000000
		0x00000000
		0x00000000
		0x00000000
		0x00000000
		0x00000000
		0x00000000
		0x00000000
		0x00000000
		0x00000000
		0x00000000
		0x00000000
		0x00000000
		0x00000000
		0x00000000
		0x00000000
		0x00000000
		0x00000000
		0x00000000
		0x00000000
		0x00000000
		0x00000000
		0x00000000
		0x00000000
		0x00000000
		0x00000000
		0x00000000
		0x00000000
		0x00000000
		0x00000000
		0x00000000
		0x00000000
		0x00000000
		0x00000000
		0x00000000
		0x00000000
		0x00000000
		0x00000000
		0x00000000
		0x00000000
		0x00000000
		0x00000000
		0x00000000
		0x00000000
		0x00000000
		0x00000000
		0x00000000
		0x00000000
		0x00000000
		0x00000000
		0x00000000
		0x00000000
		0x00000000
		0x00000000
		0x00000000
		0x00000000
		0x00000000
		0x00000000
		0x00000000
		0x00000000
		0x00000000
		0x00000000
		0x00000000
		0x00000000
		0x00000000
		0x00000000
		0x00000000
		0x00000000
		0x00000000
		0x00000000
		0x00000000
		0x00000000
		0x00000000
		0x00000000
		0x00000000
		0x00000000
		0x00000000
		0x00000000
		0x00000000
		0x00000000
		0x00000000
		0x00000000
		0x00000000
		0x00000000
		0x00000000
		0x00000000
		0x00000000
		0x00000000
		0x00000000
		0x00000000
		0x00800000
		0x00000000
		0x00000000
		0x00000000
		0x00000000
		0x00000000
		0x00000001
		0x00000000
		0x00000000
		0x00000000
		0x00400320
		0x00000040
		0x00008eca
		0x00009fdb
		0x00008eca
		0x01009fdb
		0x00020003
		0x00000000
		0x00000000
		0x00000000
		0x000556aa
		0x000aaaaa
		0x000aa955
		0x00055555
		0x000b3133
		0x0004cd33
		0x0004cecc
		0x000b32cc
		0x0004a0e6
		0x080f0000
		0x0000000f
		0x00038055
		0x03800380
		0x03800380
		0x00000380
		0x42080010
		0x00000003
		0x00000000
		0x00000000
		0x00000000
		0x00000000
		0x00000000
		0x00000000
		0x00000000
		0x00000000
		0x00000000
		0x00000000
		0x00000000
		0x00000000
		0x00000000
		0x00000000
		0x00000000
		0x00000000
		0x00000000
		0x00000000
		0x00000000
		0x00000000
		0x00000000
		0x00000000
		0x00000000
		0x00000000
		0x00000000
		0x00000000
		0x00000000
		0x00000000
		0x00000000
		0x00000000
		0x00000000
		0x00000000
		0x00000000
		0x00000000
		0x00000000
		0x00000000
		0x00000000
		0x00000000
		0x00000000
		0x00000000
		0x00000000
		0x00000000
		0x00000000
		0x00000000
		0x00000000
		0x00000000
		0x00000000
		0x00000000
		0x00000000
		0x00000000
		0x00000000
		0x00000000
		0x00000000
		0x00000000
		0x00000000
		0x00000000
		0x00000000
		0x00000000
		0x00000000
		0x00000000
		0x00000000
		0x00000000
		0x00000000
		0x00000000
		0x00000000
		0x00000000
		0x00000000
		0x00000000
		0x00000000
		0x00000000
		0x00000000
		0x00000000
		0x00000000
		0x00000000
		0x00000000
		0x00000000
		0x00000000
		0x00000000
		0x00000000
		0x00000000
		0x00000000
		0x00000000
		0x00000000
		0x00000000
		0x00000000
		0x00000000
		0x00000000
		0x00000000
		0x00000000
		0x00000000
		0x00000000
		0x00800000
		0x00000000
		0x00000000
		0x00000000
		0x00000000
		0x00000000
		0x00000001
		0x00000000
		0x00000000
		0x00000000
		0x00400320
		0x00000040
		0x00008eca
		0x00009fdb
		0x00008eca
		0x01009fdb
		0x00020003
		0x00000000
		0x00000000
		0x00000000
		0x000556aa
		0x000aaaaa
		0x000aa955
		0x00055555
		0x000b3133
		0x0004cd33
		0x0004cecc
		0x000b32cc
		0x1ee6b16a
		0x10000000
		0x00000000
		0x00038055
		0x03800380
		0x03800380
		0x00000380
		0x42080010
		0x00000003
		0x00000000
		0x00000000
		0x00000000
		0x00000000
		0x00000000
		0x00000000
		0x00000000
		0x00000000
		0x00000000
		0x00000000
		0x00000000
		0x00000000
		0x00000000
		0x00000000
		0x00000000
		0x00000000
		0x00000000
		0x00000000
		0x00000000
		0x00000000
		0x00000000
		0x00000000
		0x00000000
		0x00000000
		0x00000000
		0x00000000
		0x00000000
		0x00000000
		0x00000000
		0x00000000
		0x00000000
		0x00000000
		0x00000000
		0x00000000
		0x00000000
		0x00000000
		0x00000000
		0x00000000
		0x00000000
		0x00000000
		0x00000000
		0x00000000
		0x00000000
		0x00000000
		0x00000000
		0x00000000
		0x00000000
		0x00000000
		0x00000000
		0x00000000
		0x00000000
		0x00000000
		0x00000000
		0x00000000
		0x00000000
		0x00000000
		0x00000000
		0x00000000
		0x00000000
		0x00000000
		0x00000000
		0x00000000
		0x00000000
		0x00000000
		0x00000000
		0x00000000
		0x00000000
		0x00000000
		0x00000000
		0x00000000
		0x00000000
		0x00000000
		0x00000000
		0x00000000
		0x00000000
		0x00000000
		0x00000000
		0x00000000
		0x00000000
		0x00000000
		0x00000000
		0x00000000
		0x00000000
		0x00000000
		0x00000000
		0x00000000
		0x00000000
		0x00000000
		0x00000000
		0x00000000
		0x00000001
		0x00000000
		0x01000005
		0x04000f00
		0x00020040
		0x00020055
		0x00000000
		0x00000000
		0x00000000
		0x00000050
		0x00000000
		0x00010100
		0x00000601
		0x00000000
		0x00006400
		0x01221102
		0x00000000
		0x00051f00
		0x051f051f
		0x051f051f
		0x00030003
		0x03000300
		0x00000300
		0x01221102
		0x00000000
		0x00000000
		0x04020000
		0x00000001
		0x00000011
		0x00000011
		0x00000400
		0x00000000
		0x00000011
		0x00000011
		0x00004410
		0x00004410
		0x00004410
		0x00004410
		0x00004410
		0x00000011
		0x00004410
		0x00000011
		0x00004410
		0x00000011
		0x00004410
		0x00000000
		0x00000000
		0x00000000
		0x04000000
		0x00000000
		0x00000000
		0x00000508
		0x00000000
		0x00000000
		0x00000000
		0x00000000
		0x00000000
		0x00000000
		0xe4000000
		0x00000000
		0x00000000
		0x01010000
		0x00000000
	>;
};